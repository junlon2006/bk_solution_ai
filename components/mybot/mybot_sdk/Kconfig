## components/mybot/mybot_sdk/Kconfig
```kconfig
menu "MyBot BK7259 platform"

    choice MYBOT_LANGUAGE
        prompt "MyBot device language"
        default MYBOT_LANGUAGE_ZH_CN
        help
            Select the language used by the device service and local voice
            prompts. The endpoint and embedded prompt tag follow this choice.

        config MYBOT_LANGUAGE_ZH_CN
            bool "Chinese"

        config MYBOT_LANGUAGE_EN_US
            bool "English"
    endchoice

    # Robot V2 wires four buttons as two resistor ladders, so a key is
    # identified by its ADC channel and a voltage window rather than by a GPIO.
    # The board's fifth button drives the SoC CEN pin and resets in hardware.

    config MYBOT_KEY_ADC_CH1_CHAN
        int "MyBot key ADC channel 1 (S2 and S3)"
        range 0 15
        default 15
        help
            SARADC channel of the first resistor ladder. Robot V2 routes it to
            GPIO13 as ADC15. Both S2 and S3 are read on this channel and told
            apart by their voltage windows. Must match the CONFIG_ADC_DEV_MAP
            entry on the CP.

    config MYBOT_KEY_ADC_CH2_CHAN
        int "MyBot key ADC channel 2 (S4 and S5)"
        range 0 15
        default 4
        help
            SARADC channel of the second resistor ladder. Robot V2 routes it to
            GPIO28 as ADC4. Must match the CONFIG_ADC_DEV_MAP entry on the CP.

    config MYBOT_KEY_S2_MV_LOW
        int "MyBot S2 voltage window lower bound (mV)"
        range 0 65535
        default 500

    config MYBOT_KEY_S2_MV_HIGH
        int "MyBot S2 voltage window upper bound (mV)"
        range 0 65535
        default 1500

    config MYBOT_KEY_S3_MV_LOW
        int "MyBot S3 voltage window lower bound (mV)"
        range 0 65535
        default 4500

    config MYBOT_KEY_S3_MV_HIGH
        int "MyBot S3 voltage window upper bound (mV)"
        range 0 65535
        default 6000

    config MYBOT_KEY_S4_MV_LOW
        int "MyBot S4 voltage window lower bound (mV)"
        range 0 65535
        default 500

    config MYBOT_KEY_S4_MV_HIGH
        int "MyBot S4 voltage window upper bound (mV)"
        range 0 65535
        default 1500

    config MYBOT_KEY_S5_MV_LOW
        int "MyBot S5 voltage window lower bound (mV)"
        range 0 65535
        default 4500

    config MYBOT_KEY_S5_MV_HIGH
        int "MyBot S5 voltage window upper bound (mV)"
        range 0 65535
        default 6000

    # Voltage windows on one channel must not overlap: the driver rejects a
    # window that intersects an already registered one with BK_ERR_PARAM.

    choice MYBOT_KEY_S2_FUNCTION
        prompt "MyBot S2 function"
        default MYBOT_KEY_S2_CONVERSATION

        config MYBOT_KEY_S2_NONE
            bool "Unassigned"

        config MYBOT_KEY_S2_CONVERSATION
            bool "Conversation / provisioning"

        config MYBOT_KEY_S2_VOLUME_UP
            bool "Volume up"

        config MYBOT_KEY_S2_VOLUME_DOWN
            bool "Volume down"

        config MYBOT_KEY_S2_FACTORY_RESET
            bool "Factory reset"
            help
                Erases every persisted MyBot record (Wi-Fi credentials,
                device credentials, volume) and reboots. Needs a long press,
                so a single stray touch cannot wipe the device. The erase runs
                only after the SDK has stopped.

        config MYBOT_KEY_S2_RESERVED
            bool "Reserved"
    endchoice

    choice MYBOT_KEY_S3_FUNCTION
        prompt "MyBot S3 function"
        default MYBOT_KEY_S3_FACTORY_RESET

        config MYBOT_KEY_S3_NONE
            bool "Unassigned"

        config MYBOT_KEY_S3_CONVERSATION
            bool "Conversation / provisioning"

        config MYBOT_KEY_S3_VOLUME_UP
            bool "Volume up"

        config MYBOT_KEY_S3_VOLUME_DOWN
            bool "Volume down"

        config MYBOT_KEY_S3_FACTORY_RESET
            bool "Factory reset"
            help
                Erases every persisted MyBot record (Wi-Fi credentials,
                device credentials, volume) and reboots. Needs a long press,
                so a single stray touch cannot wipe the device. The erase runs
                only after the SDK has stopped.

        config MYBOT_KEY_S3_RESERVED
            bool "Reserved"
    endchoice

    choice MYBOT_KEY_S4_FUNCTION
        prompt "MyBot S4 function"
        default MYBOT_KEY_S4_VOLUME_DOWN

        config MYBOT_KEY_S4_NONE
            bool "Unassigned"

        config MYBOT_KEY_S4_CONVERSATION
            bool "Conversation / provisioning"

        config MYBOT_KEY_S4_VOLUME_UP
            bool "Volume up"

        config MYBOT_KEY_S4_VOLUME_DOWN
            bool "Volume down"

        config MYBOT_KEY_S4_FACTORY_RESET
            bool "Factory reset"
            help
                Erases every persisted MyBot record (Wi-Fi credentials,
                device credentials, volume) and reboots. Needs a long press,
                so a single stray touch cannot wipe the device. The erase runs
                only after the SDK has stopped.

        config MYBOT_KEY_S4_RESERVED
            bool "Reserved"
    endchoice

    choice MYBOT_KEY_S5_FUNCTION
        prompt "MyBot S5 function"
        default MYBOT_KEY_S5_VOLUME_UP

        config MYBOT_KEY_S5_NONE
            bool "Unassigned"

        config MYBOT_KEY_S5_CONVERSATION
            bool "Conversation / provisioning"

        config MYBOT_KEY_S5_VOLUME_UP
            bool "Volume up"

        config MYBOT_KEY_S5_VOLUME_DOWN
            bool "Volume down"

        config MYBOT_KEY_S5_FACTORY_RESET
            bool "Factory reset"
            help
                Erases every persisted MyBot record (Wi-Fi credentials,
                device credentials, volume) and reboots. Needs a long press,
                so a single stray touch cannot wipe the device. The erase runs
                only after the SDK has stopped.

        config MYBOT_KEY_S5_RESERVED
            bool "Reserved"

    endchoice

endmenu
```
